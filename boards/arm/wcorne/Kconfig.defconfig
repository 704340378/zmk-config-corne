## boards/arm/wcorne/Kconfig.defconfig
```kconfig
#
# Copyright (c) 2022 Darryl deHaan
# SPDX-License-Identifier: MIT
#

if BOARD_WCORNE_LEFT

config ZMK_KEYBOARD_NAME
    default "WCorne"

config ZMK_SPLIT_ROLE_CENTRAL
    default y

endif # BOARD_WCORNE_LEFT


if BOARD_WCORNE_LEFT || BOARD_WCORNE_RIGHT

config BOARD
    default "Wcorne"

config ZMK_SPLIT
    default y

config BT_CTLR
    default BT

if USB

config USB_NRFX
    default y

config USB_DEVICE_STACK
    default y

endif # USB

if USB

config USB_NRFX
    default y

config USB_DEVICE_STACK
    default y

endif # USB

endif # BOARD_WCORNE_LEFT || BOARD_WCORNE_RIGHT
```
